## drivers/input/fingerprint/Kconfig
```kconfig
#
# Fingerprints driver configuration
#
menuconfig INPUT_FINGERPRINT
	bool "FingerPrints"
	help
	  Say Y here, and a list of supported fingerprints will be displayed.
	  This option doesn't affect the kernel.

	  If unsure, say Y.

if INPUT_FINGERPRINT

config INPUT_FPC1511
        tristate "FPC1511 fingerprint sensor support"
        depends on SPI_MASTER

endif
```

## drivers/input/touchscreen/lge/lgsic/Kconfig
```kconfig
#
# LGE touch core configuration
#
if INPUT_TOUCHSCREEN

menuconfig LGE_TOUCH_LGSIC_SW49106
	bool "LGE Touch Core ODM Device Driver - SW49106"
	depends on LGE_TOUCH_CORE_BASE
	help
	  If your device is sw49106, say Y

menuconfig LGE_TOUCH_LGSIC_SW49109
	bool "LGE Touch Core ODM Device Driver - SW49109"
	depends on LGE_TOUCH_CORE_BASE
	help
	  If your device is sw49109, say Y

config LGE_TOUCH_PANEL_GLOBAL_RESET
	bool "LGE Touch panel global reset - ESD recovery"
	help
	If incell touch is applied, say Y

endif
```

## drivers/misc/lge/Kconfig
```kconfig
config GTI_CTRL
	bool  "Gyrflacon SPR Module"
	default n
	help
	  GTI Solution with Gyrfalcon SPR5801

config GTI_FW_PATH
	string "Gyrflacon SRP Module Firmwara path"
	help
	  GTI_FW_PATH is set to path of SPR5801 firmware
```

## drivers/soc/qcom/lge/Kconfig
```kconfig
config MACH_LGE
	bool "Machine LGE"
	help
	  Support for machine LGE.

menu "LGE Board Selection"

config MACH_SM6150_MH3
	bool "SM6150 MH3"
	depends on ARCH_SM6150
	select MACH_LGE
	select LGE_DM_VERITY_RECOVERY
	help
	  Support for the Qualcomm SM6150 common device.

config MACH_SM6150_MH3_LAO_COM
        bool "SM6150 MH3_LAO_COM"
        depends on ARCH_SM6150
        select MACH_LGE
        select MACH_SM6150_MH3
        help
          Support for the Qualcomm SM6150 MH3_LAO_COM device.

config MACH_SM6150_MH3_LAO_KR
        bool "SM6150 MH3_LAO_KR"
        depends on ARCH_SM6150
        select MACH_LGE
        select MACH_SM6150_MH3
        help
          Support for the Qualcomm SM6150 MH3_LAO_KR device.

config MACH_SM6150_MH3_LAO_DUMMY
        bool "SM6150 MH3_LAO_DUMMY"
        depends on ARCH_SM6150
        select MACH_LGE
        select MACH_SM6150_MH3
        help
          Support for the Qualcomm SM6150 MH3_LAO_DUMMY device.

config LGE_TARGET_DEVICE
	string  "Target Device Name"
	depends on MACH_LGE

config LGE_TARGET_PRODUCT
	string "Target Product Name"
	depends on MACH_LGE

endmenu
menu "LGE Specific Patches"

config LGE_HANDLE_PANIC
	tristate "Support LGE Crash Handler"
	default n
	depends on MACH_LGE
	select LGE_HANDLE_PANIC_RPMH_TIMEOUT
	help
	  LGE Crash Handler

config LGE_HANDLE_PANIC_RPMH_TIMEOUT
	tristate "Support LGE Crash Handler RPMH Timeout"
	default n
	depends on LGE_HANDLE_PANIC
	help
	  LGE Crash Handler

config LGE_BOOTLOADER_LOG
	tristate "Support LGE bootloader log"
	default n
	depends on MACH_LGE
	help
	  LGE bootloader log

config LGE_PSTORE_BACKUP
	tristate "Support pstore backup"
	default n
	depends on MACH_LGE
	help
	  Ramoops region is backed up to pstore partition

config LGE_BOOTLOADER_TIME_CHECKER
	tristate "Supprt bootloader(LK, SBL) time"
	default n
	depends on MACH_LGE
	help
	  Check LK, SBL booting time at
	  sys/module/lge_bootloader_time_checker/parameters/lk_time
	  sys/module/lge_bootloader_time_checker/parameters/sbl_time

config LGE_DM_VERITY_RECOVERY
	tristate "Support dm verity corrupt recovery"
	default n
	depends on MACH_LGE
	help
	  Sometimes, dm-bufio has invalid data. If data is corrupted,
	  try to recover data.

config LGE_ONE_BINARY_SKU
	tristate "Support LGE One binary sku carrier"
	default n
	depends on MACH_LGE
	help
	  LGE One Binary sku carrier

config LGE_MME_BUS
        bool "boost interface for LGE MME"
        depends on MACH_LGE
        help
          Say 'y' here to include support for the boost interface
          of msm bus to support LGE MME.

config LGE_MME_BOOST
        bool "booster for LGE MME"
        depends on LGE_MME_BUS
        help
          Say 'y' here to include support for the boost
          of msm bus to support LGE MME.

config LGE_MME_BOOST_LONG_TERM
        bool "Long term booster for LGE MME"
        depends on LGE_MME_BUS
        help
          Say 'y' here to include support for the long term boost
          of msm bus to support LGE MME.

config LGE_MME_BOOST_EBI
        bool "EBI Clock booster for LGE MME"
        depends on LGE_MME_BUS
        help
          Say 'y' here to include support for the ebi clock boost
          of msm bus to support LGE MME.

config LGE_MME_PM_QOS_DMA_LATENCY
        bool "PM QOS DMA latency for LGE MME"
        depends on LGE_MME_BUS
        help
          Say 'y' here to include support for PM QOS DMA Latency
          of msm bus to support LGE MME.

config LGE_MME_DRV_SUPPORT
        bool "Support WMC driver"
        depends on MACH_LGE
        default n
        help
          Say 'y' here to enable Wireless Magnetic Communication driver for LG pay

config LGE_MME_DRV
        tristate "WMC driver"
        depends on LGE_MME_DRV_SUPPORT
        default n
        help
          Say 'y' here to enable Wireless Magnetic Communication driver for LG pay

config LGE_PM
	tristate "Support LGE power-management"
	default n
	depends on MACH_LGE
	help
	  Global feature of LGE power-management

config LGE_PM_DEBUG
        tristate "Support LGE PM Debug Feature"
        default n
        depends on MACH_LGE
        help
          LGE PM Debug Feature

config LGE_QSDL_SUPPORT
	tristate "Support for Quality Statistics Data Logging"
	default n
	depends on MACH_LGE
	help
	  QSDL is a feature which notify infomation for quality statistics
	  data logging of device.

config LGE_PM_SMPL_COUNTER
	tristate "Support LGE SMPL COUNTER feature"
	default n
	depends on MACH_LGE
	help
	  Say y to enable smpl_cnt module, that count when
	  booted by SMPL.

config LGE_PM_THERMAL_VTS
        tristate "Support LGE Virtual Temp Sensor Feature"
        default n
        depends on MACH_LGE
        help
          LGE Virtual Temp Sensor Feature

config LGE_PM_PRM
        tristate "Support LGE Power resource manager"
        default n
        depends on MACH_LGE
        help
          LGE power resource manager

endmenu

menu "LGE QFPROM Values"

config LGE_QFPROM_INTERFACE
	bool "Support qfprom interface"
	default n
	depends on MACH_LGE
	help
	  LGE QFPROM DRIVER.

endmenu

source "drivers/soc/qcom/lge/hpue/Kconfig"
```
