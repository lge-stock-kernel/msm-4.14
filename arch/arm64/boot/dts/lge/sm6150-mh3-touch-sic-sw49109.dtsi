/*
 * Copyright (c) 2016, The Linux Foundation. All rights reserved.
 *
 * This program is free software; you can redistribute it and/or modify
 * it under the terms of the GNU General Public License version 2 and
 * only version 2 as published by the Free Software Foundation.
 *
 * This program is distributed in the hope that it will be useful,
 * but WITHOUT ANY WARRANTY; without even the implied warranty of
 * MERCHANTABILITY or FITNESS FOR A PARTICULAR PURPOSE.  See the
 * GNU General Public License for more details.
 */

&qupv3_se1_i2c {
	sw49109@28 {
		status = "okay";
		compatible = "lge,sw49109";

		reg = <0x28>;
		interrupt-parent = <&tlmm>;
		interrupts = <89 0x2002>;
		irqflags = <0x00000002>;

		reset-gpio = <&tlmm 88 0x00>;
		irq-gpio = <&tlmm 89 0x2008>;

		/* pinctrl */
		pinctrl-names = "touch_pin_active","touch_pin_sleep";	/*Touch GPIO pin name setting*/
		pinctrl-0 = <&ts_int_active &ts_reset_active>;		/*Touch GPIO pin active setting*/
		pinctrl-1 = <&ts_int_suspend &ts_reset_suspend>;	/*Touch GPIO pin suspend setting*/

		/* Caps */
		max_x = <1079>;
		max_y = <2309>;
		max_pressure = <0xff>;
		max_width_major = <2309>;
		max_width_minor = <2309>;
		max_orientation = <90>;
		max_id = <10>;
		hw_reset_delay = <210>;
		sw_reset_delay = <90>;

		/* Role */
		use_lpwg = <1>;
		use_lpwg_test = <1>;
		hide_coordinate = <1>;
		use_film_status = <0>;

		/* Firmware */
		fw_image = "touch/mh3/lgsic/L0W64MH3_V0_07.img", "touch/mh3/lgsic/L0W64MH3_V0_16.img";
		panel_spec = "touch/mh3/lgsic/mh3_siw_limit.txt", "touch/mh3/lgsic/mh3_siw_limit2.txt";
		panel_spec_mfts_folder = "touch/mh3/lgsic/mh3_siw_limit_mfts.txt", "touch/mh3/lgsic/mh3_siw_limit2_mfts.txt";

		/* Performance Test */
		use_perf_test = <1>;
		test_delay = <8>;
		test_pressure = <50>;
		test_width = <100>;
		click_test_x = <180>;
		click_test_y = <838>;
		v_drag_test_x = <144>;
		v_drag_test_start_y = <2103>;
		v_drag_test_end_y = <1216>;
		h_drag_test_start_x = <1163>;
		h_drag_test_end_x = <276>;
		h_drag_test_y = <2284>;
	};
};

