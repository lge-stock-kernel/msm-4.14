/*
 * Copyright (c) 2018, The Linux Foundation. All rights reserved.
 *
 * This program is free software; you can redistribute it and/or modify
 * it under the terms of the GNU General Public License version 2 and
 * only version 2 as published by the Free Software Foundation.
 *
 * This program is distributed in the hope that it will be useful,
 * but WITHOUT ANY WARRANTY; without even the implied warranty of
 * MERCHANTABILITY or FITNESS FOR A PARTICULAR PURPOSE.  See the
 * GNU General Public License for more details.
 */

#include <dt-bindings/interrupt-controller/arm-gic.h>
#include <dt-bindings/clock/qcom,camcc-sm6150.h>

#include "../../qcom/sm6150-idp.dtsi"

#include "mh3_common-panel.dtsi"
#include "mh3_common-pinctrl.dtsi"
#include "mh3_common-touch.dtsi"
#include "mh3_common-storage.dtsi"
#include "mh3_common-misc.dtsi"
#include "mh3_common-audio-overlay.dtsi"
#include "mh3_common-usb.dtsi"
#include "mh3_common.dtsi"
#include "mh3_lao_com-nfc.dtsi"
#include "mh3_common-pm.dtsi"
#include "mh3_common-fingerprint.dtsi"
#include "mh3_common-sar-atmf04.dtsi"
#include "../tps61280.dtsi"

