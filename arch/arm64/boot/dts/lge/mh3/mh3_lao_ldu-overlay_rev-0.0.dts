/* Copyright (c) 2018, The Linux Foundation. All rights reserved.
 *
 * This program is free software; you can redistribute it and/or modify
 * it under the terms of the GNU General Public License version 2 and
 * only version 2 as published by the Free Software Foundation.
 *
 * This program is distributed in the hope that it will be useful,
 * but WITHOUT ANY WARRANTY; without even the implied warranty of
 * MERCHANTABILITY or FITNESS FOR A PARTICULAR PURPOSE.  See the
 * GNU General Public License for more details.
 */

/dts-v1/;
/plugin/;

#include "mh3.dtsi"
#include "./mh3-camera/sm6150-mh3-camera_rev-0.0.dtsi"

/ {
	model = "LG Electronics, mh3_lao_com, rev-0.0";
	compatible = "qcom,sm6150-idp", "qcom,sm6150", "qcom,idp";
	qcom,msm-id = <355 0x0>;
	qcom,board-id = <34 0>;
};

&dsi_sw49106_fhd_video_display {
	qcom,dsi-display-active;
};

&dsi_sw49109_fhd_video_display {
	qcom,dsi-display-active;
};

&dsi_sw49109_rev1_fhd_video_display {
	qcom,dsi-display-active;
};
